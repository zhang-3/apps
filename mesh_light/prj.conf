## CMakeLists.txt
```
cmake_minimum_required(VERSION 3.8)
include($ENV{ZEPHYR_BASE}/cmake/app/boilerplate.cmake NO_POLICY_SCOPE)
project(NONE)

include_directories($ENV{ZEPHYR_BASE}/ext/hal/unisoc/)

target_sources(app PRIVATE src/main.c)
target_sources(app PRIVATE src/shell.c)
target_sources(app PRIVATE src/mesh.c)
target_sources(app PRIVATE src/light.c)
target_sources(app PRIVATE src/health.c)
```

## sample.yaml
```
sample:
  description: BT Mesh, based on UWP566X
    application
  name: mesh
  platforms: all
common:
    tags: samples
    harness: console
    harness_config:
      type: one_line
      regex:
        - "Unisoc BT Mesh(.*)"
tests:
  sample.helloworld.multithread:
    tags: samples
```

## prj.conf
```kconfig
# Configs for BLE Mesh

CONFIG_XIP=y
CONFIG_BOOTLOADER_MCUBOOT=y
CONFIG_TEXT_SECTION_OFFSET=0x1000
CONFIG_BOOT_BANNER=n

CONFIG_STDOUT_CONSOLE=y
CONFIG_SHELL=y

CONFIG_SYS_LOG=y
CONFIG_SYS_LOG_SHOW_COLOR=y
CONFIG_SYS_LOG_SHOW_TAGS=y
CONFIG_SYS_LOG_DEFAULT_LEVEL=3
CONFIG_SYS_LOG_OVERRIDE_LEVEL=3

CONFIG_HEAP_MEM_POOL_SIZE=16384
CONFIG_TEST_RANDOM_GENERATOR=y
CONFIG_TIMER_RANDOM_GENERATOR=y

CONFIG_WATCHDOG=y
CONFIG_AON_UART_UWP=y
CONFIG_SIPC=y

CONFIG_GPIO=y
CONFIG_GPIO_UWP=y
CONFIG_GPIO_UWP_P0=y

CONFIG_LED=y
CONFIG_LED_UWP=y

CONFIG_WIFI=n
CONFIG_WIFI_UWP=n


CONFIG_BT_UWP5661=y
CONFIG_BT=y
CONFIG_BT_NO_DRIVER=y
CONFIG_SYSTEM_WORKQUEUE_STACK_SIZE=4096
CONFIG_BT_RX_STACK_SIZE=4096
CONFIG_BT_RX_BUF_LEN=1024
CONFIG_BT_L2CAP_TX_MTU=255
CONFIG_BT_DEVICE_NAME="uwp5661"
CONFIG_BT_PERIPHERAL=y
CONFIG_BT_CENTRAL=y
CONFIG_BT_CONN=y
CONFIG_BT_SMP=y
CONFIG_BT_DEBUG_LOG=y

CONFIG_BT_OBSERVER=y
CONFIG_BT_BROADCASTER=y
CONFIG_BT_HCI_VS_EXT=n
CONFIG_BT_DEBUG_MONITOR=y
CONFIG_BT_DEBUG_LOG=y
CONFIG_BT_SMP=y
CONFIG_BT_TINYCRYPT_ECC=y
CONFIG_BT_MESH=y
CONFIG_BT_MESH_PROV=y
CONFIG_BT_MESH_HEALTH_CLI=y
CONFIG_BT_MESH_CFG_CLI=y
CONFIG_MAIN_STACK_SIZE=4096
CONFIG_MAIN_THREAD_PRIORITY=11
CONFIG_TEST_RANDOM_GENERATOR=y
CONFIG_TIMER_RANDOM_GENERATOR=y

CONFIG_BT_SETTINGS=y
CONFIG_FLASH=y
CONFIG_FLASH_PAGE_LAYOUT=y
CONFIG_FLASH_MAP=y
CONFIG_FCB=y
CONFIG_SETTINGS=y
CONFIG_SETTINGS_FCB=y
```

## src/main.c
```c
/*
 * SPDX-License-Identifier: Apache-2.0
 */

#include <zephyr.h>
#include <misc/printk.h>

#include "mesh.h"

#include <uwp5661/drivers/src/bt/uki_utlis.h>

void main(void)
{
	BTI("\n   [UNISOC Mesh]");

	mesh_init();

	while(1) {}
}
```

## src/health.c
```c
#include <zephyr/types.h>
#include <stddef.h>
#include <string.h>
#include <errno.h>
#include <misc/printk.h>
#include <misc/byteorder.h>
#include <zephyr.h>
#include <gpio.h>
#include <logging/sys_log.h>
#include <stdbool.h>

#include <bluetooth/bluetooth.h>
#include <bluetooth/hci.h>
#include <bluetooth/conn.h>
#include <bluetooth/uuid.h>
#include <bluetooth/gatt.h>
#include <bluetooth/mesh.h>
#include <tinycrypt/hmac_prng.h>

#include <uwp5661/drivers/src/bt/uki_utlis.h>
#include <uwp5661/drivers/src/bt/uki_config.h>

#include "mesh.h"
#include "health.h"
#include "uwp_hal.h"

static u8_t cur_faults[CUR_FAULTS_MAX];
static u8_t reg_faults[CUR_FAULTS_MAX * 2];

extern struct local_net_t local_net;

static void hl_get_faults(u8_t *faults, u8_t faults_size, u8_t *dst, u8_t *count)
{
	u8_t i, limit = *count;

	for (i = 0, *count = 0; i < faults_size && *count < limit; i++) {
		if (faults[i]) {
			*dst++ = faults[i];
			(*count)++;
		}
	}
}

static int hl_fault_get_cur(struct bt_mesh_model *model, u8_t *test_id,
			 u16_t *company_id, u8_t *faults, u8_t *fault_count)
{
	BTI("Sending current faults");

	*test_id = 0x00;
	*company_id = BT_COMP_ID_LF;

	hl_get_faults(cur_faults, sizeof(cur_faults), faults, fault_count);

	return 0;
}

static int hl_fault_get_reg(struct bt_mesh_model *model, u16_t cid,
			 u8_t *test_id, u8_t *faults, u8_t *fault_count)
{
	if (cid != BT_COMP_ID_LF) {
		BTE("Faults requested for unknown Company ID 0x%04x", cid);
		return -EINVAL;
	}

	BTI("Sending registered faults");

	*test_id = 0x00;

	hl_get_faults(reg_faults, sizeof(reg_faults), faults, fault_count);

	return 0;
}

static int hl_fault_clear(struct bt_mesh_model *model, uint16_t cid)
{
	if (cid != BT_COMP_ID_LF) {
		return -EINVAL;
	}

	memset(reg_faults, 0, sizeof(reg_faults));

	return 0;
}

static int hl_fault_test(struct bt_mesh_model *model, uint8_t test_id,
		      uint16_t cid)
{
	if (cid != BT_COMP_ID_LF) {
		return -EINVAL;
	}

	if (test_id != 0x00) {
		return -EINVAL;
	}

	return 0;
}

static void hl_attention_on(struct bt_mesh_model *model)
{
	BTI("attention_on()");
}

static void hl_attention_off(struct bt_mesh_model *model)
{
	BTI("attention_off()");
}


static const struct bt_mesh_health_srv_cb health_srv_cb = {
	.fault_get_cur = hl_fault_get_cur,
	.fault_get_reg = hl_fault_get_reg,
	.fault_clear = hl_fault_clear,
	.fault_test = hl_fault_test,
	.attn_on = hl_attention_on,
	.attn_off = hl_attention_off,
};

struct bt_mesh_health_srv health_srv = {
	.cb = &health_srv_cb,
};


void health_init(void)
{
	BTI("%s", __func__);
	struct bt_mesh_cfg_hb_pub pub = {
		.dst = GROUP_ADDR,
		.count = 0xff,
		.period = 0x05,
		.ttl = 0x07,
		.feat = 0,
		.net_idx = BT_MESH_KEY_DEV,
	};
	
	bt_mesh_cfg_hb_pub_set(local_net.net_idx, local_net.local, &pub, NULL);
	BTI("Publishing heartbeat messages");
}
```

## src/health.h
```c
#ifndef __UNISOC_HEALTH_H__
#define __UNISOC_HEALTH_H__

#include <bluetooth/bluetooth.h>
#include <bluetooth/hci.h>
#include <bluetooth/conn.h>
#include <bluetooth/uuid.h>
#include <bluetooth/gatt.h>
#include <bluetooth/mesh.h>

#define CUR_FAULTS_MAX 4

void health_init(void);

extern struct bt_mesh_health_srv health_srv;

#endif
```

## src/light.c
```c
#include <zephyr/types.h>
#include <stddef.h>
#include <string.h>
#include <errno.h>
#include <misc/printk.h>
#include <misc/byteorder.h>
#include <zephyr.h>
#include <logging/sys_log.h>
#include <stdbool.h>

#include <led.h>

#include <bluetooth/bluetooth.h>
#include <bluetooth/hci.h>
#include <bluetooth/conn.h>
#include <bluetooth/uuid.h>
#include <bluetooth/gatt.h>
#include <bluetooth/mesh.h>
#include <tinycrypt/hmac_prng.h>

#include <uwp5661/drivers/src/bt/uki_utlis.h>
#include <uwp5661/drivers/src/bt/uki_config.h>

#include "mesh.h"
#include "light.h"

#define GPIO_PORT0		"UWP_GPIO_P0"
#define LED_NAME "led"
#define BANNER_TIMEOUT K_MSEC(800)

static struct light_dev_t dev;
extern struct local_net_t local_net;

struct onoff_state leds[] = {
	{ .pin = LED1_GPIO_PIN,
	  .state = LED_STATE_OFF
	},
	{ .pin = LED2_GPIO_PIN,
	  .state = LED_STATE_OFF
	},
	{ .pin = LED3_GPIO_PIN,
	  .state = LED_STATE_OFF
	},
};

void led_all_turn_on(void)
{
	int i;
	for (i = 0; i < sizeof(leds)/sizeof(struct onoff_state); i++) {
		if (leds[i].state == LED_STATE_OFF) {
			led_on(dev.led, leds[i].pin);
			leds[i].state = LED_STATE_ON;
		}
	}
	dev.state++;
}

void led_all_turn_off(void)
{
	int i;
	for (i = 0; i < sizeof(leds)/sizeof(struct onoff_state); i++) {
		if (leds[i].state == LED_STATE_ON) {
			led_off(dev.led, leds[i].pin);
			leds[i].state = LED_STATE_OFF;
		}
	}
	dev.state--;
}


void button_pressed_worker(struct k_work *unused)
{
	if (dev.banner_running) {
		k_timer_stop(&dev.banner);
		dev.banner_running = 0;
	}

	if (dev.state) {
		led_all_turn_off();
	} else {
		led_all_turn_on();
	}

	NET_BUF_SIMPLE_DEFINE(msg, 2 + 4 + 4);
	struct bt_mesh_msg_ctx ctx = {
		.net_idx = local_net.net_idx,
		.app_idx = BT_MESH_KEY_DEV,
		.addr = 0xffff,
		.send_ttl = BT_MESH_TTL_DEFAULT,
	};

	BTI("SET LED %d", dev.state);

	bt_mesh_model_msg_init(&msg, BT_MESH_MODEL_OP_GEN_ONOFF_SET);
	net_buf_simple_add_u8(&msg, dev.state);
	net_buf_simple_add_u8(&msg, dev.tid++);
	net_buf_simple_add_u8(&msg, 0);
	net_buf_simple_add_u8(&msg, 0);
	if (bt_mesh_model_send(get_root_modules() + 4, &ctx, &msg, NULL, NULL)) {
		BTE("Unable to send On Off Status response");
	}

}

static void banner_timer_task(struct k_timer *work)
{
	static s8_t index = 0;

	if (!index) {
		index = 3;
		led_on(dev.led, leds[index - 1].pin); 
		leds[index - 1].state = LED_STATE_ON;
		BTV("LED: %d ON", index);
		return;
	}
 	
 	if (leds[index - 1].state == LED_STATE_ON) {
		led_off(dev.led, leds[index - 1].pin); 
		leds[index - 1].state = LED_STATE_OFF;
		BTV("LED: %d OFF", index);
	}

	index--;
	if (!index)
		index = 3;

	led_on(dev.led, leds[index - 1].pin);
	leds[index - 1].state = LED_STATE_ON;
	BTV("LED: %d ON", index);

	if (dev.banner_running++ > (sizeof(leds)/sizeof(struct onoff_state))) {
		k_timer_stop(&dev.banner);
		led_all_turn_off();
		dev.banner_running = 0;
	}
}

static void button_pressed(struct device *dev_t, struct gpio_callback *cb,
			   u32_t pins)
{
	BTI("%s", __func__);
	u32_t value = 0;
	gpio_pin_read(dev.button, BUTTON1_GPIO_PIN0, &value);
	if (value == -1)
		k_work_submit(&dev.button_work);
}

void light_onoff_get(struct bt_mesh_model *model,
			  struct bt_mesh_msg_ctx *ctx,
			  struct net_buf_simple *buf)
{
	BTI("%s", __func__);
}

void light_onoff_set(struct bt_mesh_model *model,
			  struct bt_mesh_msg_ctx *ctx,
			  struct net_buf_simple *buf)
{
	u8_t state = net_buf_simple_pull_u8(buf);
	u8_t tran_id = net_buf_simple_pull_u8(buf);
	u8_t tran_time = net_buf_simple_pull_u8(buf);
	u8_t delay = net_buf_simple_pull_u8(buf);

	BTI("%s %d -> %d", __func__, dev.state, state);
	BTI("tran_id: %d, tran_time: 0x%02x, delay, %d", tran_id, tran_time, delay);

	if (dev.banner_running) {
		k_timer_stop(&dev.banner);
		dev.banner_running = 0;
	}

	if (state == dev.state) {
		return;
	}

	if (state) {
		led_all_turn_on();
	} else {
		led_all_turn_off();
	}
}


void light_onoff_set_unack(struct bt_mesh_model *model,
				struct bt_mesh_msg_ctx *ctx,
				struct net_buf_simple *buf)
{
	BTD("%s", __func__);
}



const struct bt_mesh_model_op light_onoff_srv_op[] = {
	{ BT_MESH_MODEL_OP_GEN_ONOFF_GET, 0, light_onoff_get },
	{ BT_MESH_MODEL_OP_GEN_ONOFF_SET, 4, light_onoff_set },
	{ BT_MESH_MODEL_OP_GEN_ONOFF_SET_UNACK, 2, light_onoff_set_unack },
	BT_MESH_MODEL_OP_END,
};

static void lightness_get(struct bt_mesh_model *model,
                          struct bt_mesh_msg_ctx *ctx,
                          struct net_buf_simple *buf)
{
	BTI("%s", __func__);
}

static void lightness_set(struct bt_mesh_model *model,
                          struct bt_mesh_msg_ctx *ctx,
                          struct net_buf_simple *buf)
{
	BTI("%s", __func__);
}

static void lightness_set_unack(struct bt_mesh_model *model,
                                struct bt_mesh_msg_ctx *ctx,
                                struct net_buf_simple *buf)
{
	BTI("%s", __func__);
}

static void lightness_status(struct bt_mesh_model *model,
                             struct bt_mesh_msg_ctx *ctx,
                             struct net_buf_simple *buf)
{
	BTI("%s", __func__);
}

static void lightness_linear_get(struct bt_mesh_model *model,
                                 struct bt_mesh_msg_ctx *ctx,
                                 struct net_buf_simple *buf)
{
	BTI("%s", __func__);
}

static void lightness_linear_set(struct bt_mesh_model *model,
                                 struct bt_mesh_msg_ctx *ctx,
                                 struct net_buf_simple *buf)
{
	BTI("%s", __func__);
}

static void lightness_linear_set_unack(struct bt_mesh_model *model,
                                       struct bt_mesh_msg_ctx *ctx,
                                       struct net_buf_simple *buf)
{
	BTI("%s", __func__);
}

static void lightness_linear_status(struct bt_mesh_model *model,
                                    struct bt_mesh_msg_ctx *ctx,
                                    struct net_buf_simple *buf)
{
	BTI("%s", __func__);
}

static void lightness_last_get(struct bt_mesh_model *model,
                               struct bt_mesh_msg_ctx *ctx,
                               struct net_buf_simple *buf)
{
	BTI("%s", __func__);
}

static void lightness_last_status(struct bt_mesh_model *model,
                                  struct bt_mesh_msg_ctx *ctx,
                                  struct net_buf_simple *buf)
{
	BTI("%s", __func__);
}

static void lightness_default_get(struct bt_mesh_model *model,
                                  struct bt_mesh_msg_ctx *ctx,
                                  struct net_buf_simple *buf)
{
	BTI("%s", __func__);
}

static void lightness_default_status(struct bt_mesh_model *model,
                                     struct bt_mesh_msg_ctx *ctx,
                                     struct net_buf_simple *buf)
{
	BTI("%s", __func__);
}

static void lightness_range_get(struct bt_mesh_model *model,
                                struct bt_mesh_msg_ctx *ctx,
                                struct net_buf_simple *buf)
{
	BTI("%s", __func__);
}

static void lightness_range_status(struct bt_mesh_model *model,
                                   struct bt_mesh_msg_ctx *ctx,
                                   struct net_buf_simple *buf)
{
	BTI("%s", __func__);
}


const struct bt_mesh_model_op lightness_srv_op[] = {
    { BT_MESH_MODEL_OP_2(0x82, 0x4b), 2, lightness_get },
    { BT_MESH_MODEL_OP_2(0x82, 0x4c), 2, lightness_set },
    { BT_MESH_MODEL_OP_2(0x82, 0x4d), 2, lightness_set_unack },
    { BT_MESH_MODEL_OP_2(0x82, 0x4e), 2, lightness_status },
    { BT_MESH_MODEL_OP_2(0x82, 0x4f), 2, lightness_linear_get },
    { BT_MESH_MODEL_OP_2(0x82, 0x50), 2, lightness_linear_set },
    { BT_MESH_MODEL_OP_2(0x82, 0x51), 2, lightness_linear_set_unack },
    { BT_MESH_MODEL_OP_2(0x82, 0x52), 2, lightness_linear_status },
    { BT_MESH_MODEL_OP_2(0x82, 0x53), 2, lightness_last_get },
    { BT_MESH_MODEL_OP_2(0x82, 0x54), 2, lightness_last_status },
    { BT_MESH_MODEL_OP_2(0x82, 0x55), 2, lightness_default_get },
    { BT_MESH_MODEL_OP_2(0x82, 0x56), 2, lightness_default_status },
    { BT_MESH_MODEL_OP_2(0x82, 0x57), 2, lightness_range_get },
    { BT_MESH_MODEL_OP_2(0x82, 0x58), 2, lightness_range_status },
    BT_MESH_MODEL_OP_END,
};



static void lightness_setup_default_set(struct bt_mesh_model *model,
                                        struct bt_mesh_msg_ctx *ctx,
                                        struct net_buf_simple *buf)
{
	BTI("%s", __func__);
}

static void lightness_setup_default_set_unack(struct bt_mesh_model *model,
                                              struct bt_mesh_msg_ctx *ctx,
                                              struct net_buf_simple *buf)
{
	BTI("%s", __func__);
}

static void lightness_setup_range_set(struct bt_mesh_model *model,
                                      struct bt_mesh_msg_ctx *ctx,
                                      struct net_buf_simple *buf)
{
	BTI("%s", __func__);
}

static void lightness_setup_range_set_unack(struct bt_mesh_model *model,
                                            struct bt_mesh_msg_ctx *ctx,
                                            struct net_buf_simple *buf)
{
	BTI("%s", __func__);
}


const struct bt_mesh_model_op lightness_setup_srv_op[] = {
    { BT_MESH_MODEL_OP_2(0x82, 0x59), 2, lightness_setup_default_set },
    { BT_MESH_MODEL_OP_2(0x82, 0x5a), 2, lightness_setup_default_set_unack },
    { BT_MESH_MODEL_OP_2(0x82, 0x5b), 2, lightness_setup_range_set },
    { BT_MESH_MODEL_OP_2(0x82, 0x5c), 2, lightness_setup_range_set_unack },
    BT_MESH_MODEL_OP_END,
};

void gpio_init(void)
{
	dev.button = device_get_binding(GPIO_PORT0);
	dev.led = device_get_binding(LED_NAME);
	gpio_pin_configure(dev.button, BUTTON1_GPIO_PIN0,
			   (GPIO_DIR_IN | GPIO_INT | GPIO_INT_EDGE
			   | GPIO_PUD_PULL_UP
			   | GPIO_INT_ACTIVE_LOW));
	unsigned int *p = (unsigned int*)(0x40840010);
	*p = *p | (1 << 8);

	gpio_init_callback(&dev.button_cb, button_pressed,
			   BIT(BUTTON1_GPIO_PIN0));
	gpio_add_callback(dev.button, &dev.button_cb);
	gpio_pin_enable_callback(dev.button, BUTTON1_GPIO_PIN0);

}


void light_startup(void)
{
	k_timer_start(&dev.banner, 0, 800);
}

void light_init(void)
{
	BTI("%s", __func__);

	memset(&dev, 0 , sizeof(struct light_dev_t));
	gpio_init();
	k_work_init(&dev.button_work, button_pressed_worker);
	k_timer_init(&dev.banner, banner_timer_task, NULL);
}
```

## src/light.h
```c
#ifndef __UNISOC_LIGHT_H__
#define __UNISOC_LIGHT_H__

#include <bluetooth/bluetooth.h>
#include <bluetooth/hci.h>
#include <bluetooth/conn.h>
#include <bluetooth/uuid.h>
#include <bluetooth/gatt.h>
#include <bluetooth/mesh.h>

#include <gpio.h>

#define BUTTON1_GPIO_PIN0 0
#define LED1_GPIO_PIN 1
#define LED2_GPIO_PIN 3
#define LED3_GPIO_PIN 2

#define LED_STATE_OFF 0
#define LED_STATE_ON 1

#define LED_OFF_VALUE 1
#define LED_ON_VALUE 0

struct light_dev_t{
	u8_t state;
	u8_t tid;
	u8_t banner_running;
	struct device *button;
	struct device *led;
	struct gpio_callback button_cb;
	struct k_work startup_work;
	struct k_work button_work;
	struct k_timer banner;
};



#define BT_MESH_MODEL_OP_GEN_ONOFF_GET		BT_MESH_MODEL_OP_2(0x82, 0x01)
#define BT_MESH_MODEL_OP_GEN_ONOFF_SET		BT_MESH_MODEL_OP_2(0x82, 0x02)
#define BT_MESH_MODEL_OP_GEN_ONOFF_SET_UNACK	BT_MESH_MODEL_OP_2(0x82, 0x03)
#define BT_MESH_MODEL_OP_GEN_ONOFF_STATUS	BT_MESH_MODEL_OP_2(0x82, 0x04)

struct onoff_state {
	u8_t current;
	u8_t previous;
	u32_t pin;
	u8_t state;
	struct device *led_device;
};

void light_init(void);
void light_startup(void);
void light_onoff_get(struct bt_mesh_model *model,
			  struct bt_mesh_msg_ctx *ctx,
			  struct net_buf_simple *buf);
void light_onoff_set(struct bt_mesh_model *model,
			  struct bt_mesh_msg_ctx *ctx,
			  struct net_buf_simple *buf);
void light_onoff_set_unack(struct bt_mesh_model *model,
				struct bt_mesh_msg_ctx *ctx,
				struct net_buf_simple *buf);


void led_all_turn_on(void);
void led_all_turn_off(void);


extern struct onoff_state leds[];
extern const struct bt_mesh_model_op light_onoff_srv_op[];
extern const struct bt_mesh_model_op lightness_srv_op[];
extern const struct bt_mesh_model_op lightness_setup_srv_op[];

#endif
```

## src/mesh.c
```c
#include <zephyr/types.h>
#include <stddef.h>
#include <string.h>
#include <stdlib.h>
#include <stdio.h>
#include <errno.h>
#include <misc/printk.h>
#include <misc/byteorder.h>
#include <zephyr.h>
#include <gpio.h>
#include <logging/sys_log.h>
#include <stdbool.h>

#include <tinycrypt/sha256.h>
#include <tinycrypt/constants.h>

#include <uwp5661/drivers/src/bt/uki_utlis.h>
#include <uwp5661/drivers/src/bt/uki_config.h>

#include <settings/settings.h>

#include "mesh.h"
#include "light.h"
#include "health.h"

#if !defined(NODE_ADDR)
#define NODE_ADDR 0x0b0c
#endif

static struct {
	u8_t *pid;
	u8_t *pst;
	u8_t *mac;
} ali_auth[] = {
	{"767", "38d82edb69246269ddea5fa4dd04aa63", "78da07d435d8"},
	{"767", "44d0fa07fd5493b3ec3328f496f9dbcf", "78da07d435d9"},
	{"767", "bb2accd80b11e72d602fe3856bfa0280", "78da07d435da"},
	{"898", "cec73f2b36e5c2a8151b6d610408eaf1", "78da07ec0de1"},
	{"898", "5ce75a1e7affde9e432f1277bee721e1", "78da07ec0de2"},
	{"898", "89d5085bdfde54d46de147a84227d7b3", "78da07ec0de3"},
};
#define ALI_AUTH_ID 0


struct local_net_t local_net;
static struct mesh_config_t mesh_config;

static struct bt_mesh_cfg_srv cfg_srv = {
	.relay = BT_MESH_RELAY_DISABLED,
	.beacon = BT_MESH_BEACON_DISABLED,
#if defined(CONFIG_BT_MESH_FRIEND)
	.frnd = BT_MESH_FRIEND_DISABLED,
#else
	.frnd = BT_MESH_FRIEND_NOT_SUPPORTED,
#endif
#if defined(CONFIG_BT_MESH_GATT_PROXY)
	.gatt_proxy = BT_MESH_GATT_PROXY_DISABLED,
#else
	.gatt_proxy = BT_MESH_GATT_PROXY_NOT_SUPPORTED,
#endif

	.default_ttl = 7,

	/* 3 transmissions with 20ms interval */
	.net_transmit = BT_MESH_TRANSMIT(2, 20),
	.relay_retransmit = BT_MESH_TRANSMIT(2, 20),
};


static struct bt_mesh_cfg_cli cfg_cli = {
};


BT_MESH_HEALTH_PUB_DEFINE(health_pub, CUR_FAULTS_MAX);
BT_MESH_MODEL_PUB_DEFINE(light_onoff_pub_srv, NULL, 2 + 2);
BT_MESH_HEALTH_PUB_DEFINE(lightness_srv_pub, CUR_FAULTS_MAX);
BT_MESH_HEALTH_PUB_DEFINE(lightness_setup_srv_pub, CUR_FAULTS_MAX);

static struct bt_mesh_model root_models[] = {
	BT_MESH_MODEL_CFG_SRV(&cfg_srv),
	BT_MESH_MODEL_CFG_CLI(&cfg_cli),
	BT_MESH_MODEL_HEALTH_SRV(&health_srv, &health_pub),
	BT_MESH_MODEL(BT_MESH_MODEL_ID_GEN_ONOFF_SRV, light_onoff_srv_op,
			  &light_onoff_pub_srv, &leds[0]),
	BT_MESH_MODEL(BT_MESH_MODEL_ID_LIGHT_LIGHTNESS_SRV, lightness_srv_op,
    &lightness_srv_pub, NULL),
    BT_MESH_MODEL(BT_MESH_MODEL_ID_LIGHT_LIGHTNESS_SETUP_SRV, lightness_setup_srv_op,
    &lightness_setup_srv_pub, NULL),
};


static struct bt_mesh_elem elements[] = {
	BT_MESH_ELEM(0, root_models, BT_MESH_MODEL_NONE),
};

static const struct bt_mesh_comp comp = {
	.cid = BT_COMP_ID,
	.elem = elements,
	.elem_count = ARRAY_SIZE(elements),
};

static void prov_complete(u16_t net_idx, u16_t addr)
{
	BTI("Local node provisioned, net_idx 0x%04x address 0x%04x",
	       net_idx, addr);
	local_net.net_idx = net_idx,
	local_net.local = addr;

	if (mesh_config.health_enabled)
		health_init();

	if (mesh_config.light_enabled)
		light_startup();
}

static void prov_reset(void)
{
	BTI("The local node has been reset and needs reprovisioning");
	bt_mesh_prov_enable(BT_MESH_PROV_GATT | BT_MESH_PROV_ADV);
}

static int output_number(bt_mesh_output_action_t action, uint32_t number)
{
	BTI("OOB Number: %u", number);
	return 0;
}

static int output_string(const char *str)
{
	BTI("OOB String: %s", str);
	return 0;
}

static const char *bearer2str(bt_mesh_prov_bearer_t bearer)
{
	switch (bearer) {
	case BT_MESH_PROV_ADV:
		return "PB-ADV";
	case BT_MESH_PROV_GATT:
		return "PB-GATT";
	default:
		return "unknown";
	}
}

static void link_open(bt_mesh_prov_bearer_t bearer)
{
	BTI("Provisioning link opened on %s", bearer2str(bearer));
}

static void link_close(bt_mesh_prov_bearer_t bearer)
{
	BTI("Provisioning link closed on %s", bearer2str(bearer));
}

static int input(bt_mesh_input_action_t act, u8_t size)
{
	switch (act) {
	case BT_MESH_ENTER_NUMBER:
		BTI("Enter a number (max %u digits) with: input-num <num>",
		       size);
		break;
	case BT_MESH_ENTER_STRING:
		BTI("Enter a string (max %u chars) with: input-str <str>",
		       size);
		break;
	default:
		BTI("Unknown input action %u (size %u) requested!",
		       act, size);
		return -EINVAL;
	}

	local_net.input_act = act;
	local_net.input_size = size;
	return 0;
}

static u8_t static_auth[16] = {0};

static struct bt_mesh_prov prov = {
	.uuid = local_net.uuid,
	.link_open = link_open,
	.link_close = link_close,
	.complete = prov_complete,
	.reset = prov_reset,
	.static_val = static_auth,
	.static_val_len = sizeof(static_auth),
	.output_size = 0,
	.output_actions = 0,
	.input_size = 0,
	.input_actions = 0,
	.output_number = output_number,
	.output_string = output_string,
	.input = input,
};


static void alimesh_init(void)
{
	static struct tc_sha256_state_struct sha256_ctx;
	uint8_t *p = local_net.uuid;
	int ret;
	char static_value[100] = {0};
	uint8_t result[100] = {0};

	UINT16_TO_STREAM(p, ALI_COMP_ID);
	*p++ = 0x71;
	UINT32_TO_STREAM(p, mesh_config.ali_pid);
	sys_memcpy_swap(p, mesh_config.ali_mac, sizeof(mesh_config.ali_mac));
	p += sizeof(mesh_config.ali_mac);
	memset(p, 0, local_net.uuid + sizeof(local_net.uuid) - p);
	uki_hex_dump_block("UUID:", local_net.uuid, sizeof(local_net.uuid));

	p = static_value;

	ret = snprintf(p, sizeof(static_value),
		"%08x,", mesh_config.ali_pid);
	p += ret;
	uki_hex(p, mesh_config.ali_mac, sizeof(mesh_config.ali_mac));
	p += sizeof(mesh_config.ali_mac) * 2;

	*p++ = ',';

	uki_hex(p, mesh_config.ali_secret, sizeof(mesh_config.ali_secret));
	BTE("ALI KEY: %s", static_value);

	ret = tc_sha256_init(&sha256_ctx);
    if (ret != TC_CRYPTO_SUCCESS) {
        BTE("sha256 init fail");
    }

    ret = tc_sha256_update(&sha256_ctx, static_value, strlen(static_value));
    if (ret != TC_CRYPTO_SUCCESS) {
        BTE("sha256 udpate fail");
    }

    ret = tc_sha256_final(result, &sha256_ctx);
    if (ret != TC_CRYPTO_SUCCESS) {
        BTE("sha256 final fail");
    }

	memcpy(static_auth, result, sizeof(static_auth));

	uki_hexdump("static value:", static_auth, sizeof(static_auth));
}


static void mesh_enable(int err)
{
	if (err) {
		BTI("Bluetooth init failed (err %d)", err);
		return;
	}

	BTI("Bluetooth initialized");

	light_init();

	if (mesh_config.ali_mesh) {
		alimesh_init();
	}

	err = bt_mesh_init(&prov, &comp);
	if (err) {
		BTI("Initializing mesh failed (err %d)", err);
		return;
	}

	BTI("Mesh initialized");

	if (IS_ENABLED(CONFIG_BT_SETTINGS)) {
		BTI("Loading stored settings");
		settings_load();
	}

	if (mesh_config.proved) {
		const u8_t net_key[16] = {
			0x88, 0x23, 0x45, 0x67, 0x89, 0xab, 0xcd, 0xef,
			0x88, 0x23, 0x45, 0x67, 0x89, 0xab, 0xcd, 0xef,
		};
		const u8_t dev_key[16] = {
			0x88, 0x23, 0x45, 0x67, 0x89, 0xab, 0xcd, 0xef,
			0x88, 0x23, 0x45, 0x67, 0x89, 0xab, 0xcd, 0xef,
		};
		const u8_t app_key[16] = {
			0x88, 0x23, 0x45, 0x67, 0x89, 0xab, 0xcd, 0xef,
			0x88, 0x23, 0x45, 0x67, 0x89, 0xab, 0xcd, 0xef,
		};
		const u16_t net_idx = 0;
		const u16_t app_idx = 0;
		u8_t flags = 0;
		u16_t addr = GROUP_ADDR;
		const u32_t iv_index = 0;


		BTI("provision local node");
		addr = sys_rand32_get() & 0x7FFF;
		BTI("Node address: 0x%04X", addr);

		err = bt_mesh_provision(net_key, net_idx, flags, iv_index, addr,
					dev_key);
		if (err == -EALREADY) {
			BTI("Using stored settings");
		} else if (err) {
			BTI("Provisioning failed (err %d)", err);
			return;
		} else {
			BTI("Provisioning completed & Configuring...");
			
			/* Add Application Key */
			bt_mesh_cfg_app_key_add(net_idx, addr, net_idx, app_idx, app_key, NULL);
			
			if (mesh_config.health_enabled) {
				/* Bind to Health model */
				bt_mesh_cfg_mod_app_bind(net_idx, addr, addr, app_idx,
					BT_MESH_MODEL_ID_HEALTH_SRV, NULL);
			}

			if (mesh_config.light_enabled) {
				bt_mesh_cfg_mod_app_bind(net_idx, addr, addr, app_idx,
					BT_MESH_MODEL_ID_GEN_ONOFF_SRV, NULL);
			}
			
			BTV("Configuration complete");
		}
	} else {
		bt_mesh_prov_enable(BT_MESH_PROV_GATT | BT_MESH_PROV_ADV);
	}

}


void config_load(void)
{
	memset(&local_net, 0, sizeof(struct local_net_t));
	memset(&mesh_config, 0, sizeof(struct mesh_config_t));

	mesh_config.ali_mesh = 1;
	mesh_config.ali_pid = (uint32_t)(strtol(ali_auth[ALI_AUTH_ID].pid,
		NULL, 10) & 0xFFFFFFFF);
	uki_str2hex(mesh_config.ali_secret, ali_auth[ALI_AUTH_ID].pst,
		sizeof(mesh_config.ali_secret));
	uki_str2hex(mesh_config.ali_mac, ali_auth[ALI_AUTH_ID].mac,
		sizeof(mesh_config.ali_mac));
}

void mesh_init(void)
{
	int err;

	BTI("%s", __func__);


	config_load();
	err = bt_enable(mesh_enable);
	if (err) {
		BTE("Bluetooth init failed (err %d)", err);
		return;
	}
}

struct bt_mesh_model *get_root_modules(void)
{
	return &root_models[0];
}


void mesh_info(void)
{
	BTD("%s", __func__);
	BTI("Current addr: 0x%02X", local_net.local);
}
```

## src/mesh.h
```c
#ifndef __UNISOC_MESH_H__
#define __UNISOC_MESH_H__

#include <bluetooth/bluetooth.h>
#include <bluetooth/hci.h>
#include <bluetooth/conn.h>
#include <bluetooth/uuid.h>
#include <bluetooth/gatt.h>
#include <bluetooth/mesh.h>
#include <tinycrypt/hmac_prng.h>

#define GROUP_ADDR 0xc000
#define PUBLISHER_ADDR  0x000f

#define BT_COMP_ID           0x01EC
#define ALI_COMP_ID           0x01A8
#define MOD_ID 0x1688
#define OP_VENDOR_ACTION BT_MESH_MODEL_OP_3(0x00, BT_COMP_ID)

struct local_net_t {
	u16_t local;
	u16_t dst;
	u16_t net_idx;
	u16_t app_idx;
	bt_mesh_input_action_t input_act;
	u8_t input_size;
	u8_t uuid[16];
};


struct mesh_config_t{
    uint8_t  address[6];
    uint8_t  health_enabled;
    uint8_t  light_enabled;
    uint8_t  net_key[16];
    uint8_t  device_key[16];
    uint8_t  app_key[16];
    uint16_t  node_address;
    uint16_t firmware_log_level;
	uint16_t proved;

/*
* Ali Genie
*/
	uint8_t ali_mesh;
	uint32_t ali_pid;
	uint8_t ali_mac[6];
    uint8_t ali_secret[16];
};

int cmd_mesh(int argc, char *argv[]);
int cmd_led(int argc, char *argv[]);
void mesh_init(void);

u16_t get_net_idx(void);
u16_t get_app_idx(void);
u32_t get_iv_index(void);
struct bt_mesh_model *get_root_modules(void);
u16_t get_addr(void);


#endif
```

## src/shell.c
```c
/*
 * SPDX-License-Identifier: Apache-2.0
 */

#include <zephyr.h>
#include <misc/printk.h>
#include <shell/shell.h>
#include <stdlib.h>
#include <version.h>

#include <led.h>

#define LED_NAME "led"

#include <uwp5661/drivers/src/bt/uki_utlis.h>

u32_t str2hex(char *s)
{
	u32_t val = 0;
	int len;
	int i;
	char c;

	if (strncmp(s, "0x", 2) && strncmp(s, "0X", 2)) {
		BTE("Invalid hex string: %s.", s);
		return 0;
	}

	/* skip 0x */
	s += 2;

	len = strlen(s);
	if (len > 8) {
		BTE("Invalid hex string.");
		return 0;
	}

	for (i = 0; i < len; i++) {
		c = *s;

		/* 0 - 9 */
		if (c >= '0' && c <= '9')
			c -= '0';
		else if (c >= 'A' && c <= 'F')
			c = c - 'A' + 10;
		else if (c >= 'a' && c <= 'f')
			c = c - 'a' + 10;
		else {
			BTE("Invalid hex string.");
			return 0;
		}

		val = val * 16 + c;

		s++;
	}

	return val;
}

u32_t str2data(char *s)
{
	if (strncmp(s, "0x", 2) == 0 || strncmp(s, "0X", 2) == 0)
		return str2hex(s);
	else
		return atoi(s);
}
void read8_cmd_exe(u32_t addr, u32_t len)
{
	int i;

	printk("Read %d bytes from 0x%x:\n", len, addr);

	for (i = 0; i < len; i++, addr++) {
		if (i%16 == 0)
			printk("\n%08x: ", addr);
		printk("%02x ", sys_read8(addr));
	}
	printk("\n");
}

static int cmd_read8(const struct shell *shell, size_t argc, char **argv)
{
	u32_t addr;
	u32_t len;
	int err = shell_cmd_precheck(shell, (argc == 3), NULL, 0);

	if (err) {
		return err;
	}

	addr = (u32_t)str2data(argv[1]);
	len = str2data(argv[2]);

	read8_cmd_exe(addr, len);

	return 0;
}
void read32_cmd_exe(u32_t addr, u32_t len)
{
	int i;

	printk("Read %d words from 0x%x:\n", len, addr);

	for (i = 0; i < len; i++, addr += 4) {
		if (i%4 == 0)
			printk("\n%08x: ", addr);
		printk("%08x ", sys_read32(addr));
	}
	printk("\n");
}

static int cmd_read32(const struct shell *shell, size_t argc, char **argv)
{
	u32_t addr;
	u32_t len;
	int err = shell_cmd_precheck(shell, (argc == 3), NULL, 0);

	if (err) {
		return err;
	}

	addr = (u32_t)str2data(argv[1]);
	len = str2data(argv[2]);

	read32_cmd_exe(addr, len);

	return 0;
}

static int cmd_write(const struct shell *shell, size_t argc, char **argv)
{
	u32_t p;
	u32_t val;
	int err = shell_cmd_precheck(shell, (argc == 3), NULL, 0);

	if (err) {
		return err;
	}

	p = str2data(argv[1]);
	val = str2data(argv[2]);

	sys_write32(val, p);

	shell_fprintf(shell, SHELL_NORMAL,
			"Write data 0x%x to address 0x%x success.",
			val, p);

	return 0;
}


static int cmd_version(const struct shell *shell, size_t argc, char **argv)
{
	ARG_UNUSED(argc);
	ARG_UNUSED(argv);

	shell_fprintf(shell, SHELL_NORMAL,
			"Zephyr version %s\n", KERNEL_VERSION_STRING);
	return 0;
}


static int cmd_led(const struct shell *shell, size_t argc, char **argv)
{
	static int state;
	struct device *dev;

	dev = device_get_binding(LED_NAME);

	if (state) {
		shell_fprintf(shell, SHELL_NORMAL,
				"LED OFF\n");
		led_off(dev, 1);
		led_off(dev, 2);
		led_off(dev, 3);
	} else {
		shell_fprintf(shell, SHELL_NORMAL,
				"LED ON\n");
		led_on(dev, 1);
		led_on(dev, 2);
		led_on(dev, 3);
	}
	state = !state;

	return 0;
}


SHELL_CREATE_STATIC_SUBCMD_SET(bmesh_cmds) {
	SHELL_CMD(version, NULL, "Void", cmd_version),
	SHELL_CMD(read8, NULL, "Void", cmd_read8),
	SHELL_CMD(read32, NULL, "Void", cmd_read32),
	SHELL_CMD(write, NULL, "Void", cmd_write),
	SHELL_CMD(led, NULL, "Void", cmd_led),

	SHELL_SUBCMD_SET_END
};

static int cmd_bt(const struct shell *shell, size_t argc, char **argv)
{
	int err;

	if (argc == 1) {
		shell_help_print(shell, NULL, 0);
		/* shell_cmd_precheck returns 1 when help is printed */
		return 1;
	}

	err = shell_cmd_precheck(shell, (argc == 2), NULL, 0);
	if (err) {
		return err;
	}

	shell_fprintf(shell, SHELL_NORMAL, "%s unknown parameter: %s", argv[0], argv[1]);

	return -EINVAL;
}

SHELL_CMD_REGISTER(bmesh, &bmesh_cmds, "Bluetooth shell commands", cmd_bt);
```
