## CMakeLists.txt
```
cmake_minimum_required(VERSION 3.8)
include($ENV{ZEPHYR_BASE}/cmake/app/boilerplate.cmake NO_POLICY_SCOPE)
project(NONE)

target_sources(app PRIVATE src/main.c)

include_directories($ENV{ZEPHYR_BASE}/ext/hal/unisoc/)
```

## sample.yaml
```
sample:
  description: Audio Demo, based on UWP566X
    application
  name: audio
  platforms: all
common:
    tags: samples
    harness: console
    harness_config:
      type: one_line
      regex:
        - "Unisoc AUDIO Demo(.*)"
tests:
  sample.helloworld.multithread:
    tags: samples
```

## prj.conf
```kconfig
# Configs for Repeater

CONFIG_XIP=y
CONFIG_BOOTLOADER_MCUBOOT=y
CONFIG_TEXT_SECTION_OFFSET=0x1000
CONFIG_BOOT_BANNER=n
CONFIG_NEWLIB_LIBC=y

CONFIG_STDOUT_CONSOLE=y
CONFIG_SHELL=y
CONFIG_LOG=y

#CONFIG_HEAP_MEM_POOL_SIZE=16384

CONFIG_WATCHDOG=n
CONFIG_FLASH=n
CONFIG_FLASH_MAP=n
CONFIG_FCB=n
CONFIG_SETTINGS=n
```

## src/main.c
```c
/*
 * SPDX-License-Identifier: Apache-2.0
 */

#include <zephyr.h>
#include <misc/printk.h>

void main(void)
{
	printk("   [UNISOC Audio Demo]\n");

	while(1) {}
}
```
