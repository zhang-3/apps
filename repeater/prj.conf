## CMakeLists.txt
```
cmake_minimum_required(VERSION 3.8)
include($ENV{ZEPHYR_BASE}/cmake/app/boilerplate.cmake NO_POLICY_SCOPE)
project(NONE)

target_sources(app PRIVATE src/main.c)
target_sources(app PRIVATE src/shell.c)
#target_sources(app PRIVATE src/test.c)

include_directories($ENV{ZEPHYR_BASE}/ext/hal/unisoc/)

target_sources_ifdef(
  CONFIG_BT_UWP5661
  app PRIVATE
  src/bluetooth/blues.c
  src/bluetooth/throughput.c
  )

#target_sources_ifdef(
#  CONFIG_WIFIMGR
#  app PRIVATE
#  src/bluetooth/wifi_manager_service.c
#  )

target_sources_ifdef(
  CONFIG_FLASH_TEST
  app PRIVATE
  src/sfc/sfc_flash_test.c
  )

target_sources_ifdef(
  CONFIG_OTA
  app PRIVATE
  src/ota/ota_shell.c
  )

add_subdirectory_ifdef(CONFIG_DHRYSTONE	dhrystone)
add_subdirectory_ifdef(CONFIG_ENGPC	engpc)
add_subdirectory_ifdef(CONFIG_IWNPI	iwnpi)
add_subdirectory_ifdef(CONFIG_BT_TEST	bt_test)
```

## Kconfig
```
#
# SPDX-License-Identifier: Apache-2.0
#

mainmenu "Wi-Fi repeater"

module = REPEATER
module-dep = LOG
module-str = repeater
module-help = Sets log level for repeater application.
source "subsys/logging/Kconfig.template.log_config"

source "Kconfig.zephyr"

config DHRYSTONE
        bool "dhrystone benchmark"
	help
           Enable the dhrystone benchmark.

config ENGPC
	bool "ENGPC test tool"
	depends on IWNPI
	depends on BT_TEST
	depends on GPIO_UWP
	help
	   Enable ENGPC test tool for bt/wifi npi test

config IWNPI
	bool "iwnpi tool for wifi npi test"
	select NETWORKING
	depends on WIFI_UWP
	help
	   Enable the iwnpi tool for wifi npi test

config BT_TEST
	bool "test tool for bt npi"
	depends on BT_UWP5661
	help
	   Enable the bt npi test

config FLASH_TEST
	bool "test tool for flash npi"
	help
	   Enable the flash test

config OTA
	bool
	select HTTP
	select HTTP_CLINET
	help
	   Enable ota
```

## prj.conf
```kconfig
# Configs for Repeater

CONFIG_XIP=y
CONFIG_BOOTLOADER_MCUBOOT=y
CONFIG_TEXT_SECTION_OFFSET=0x1000
CONFIG_OPENOCD_SUPPORT=y
CONFIG_BOOT_BANNER=n
CONFIG_ASSERT=y
CONFIG_SPEED_OPTIMIZATIONS=y
CONFIG_NEWLIB_LIBC=y
CONFIG_NEWLIB_LIBC_FLOAT_PRINTF=y

CONFIG_SHELL=y
CONFIG_KERNEL_SHELL=y
CONFIG_DEVICE_SHELL=y

CONFIG_LOG=y
#CONFIG_LOG_BACKEND_UART=y
#CONFIG_LOG_IMMEDIATE=y
CONFIG_LOG_PROCESS_TRIGGER_THRESHOLD=0
CONFIG_LOG_STRDUP_MAX_STRING=128
CONFIG_LOG_STRDUP_BUF_COUNT=16
CONFIG_REPEATER_LOG_LEVEL_DBG=y
CONFIG_UWP_HAL_LOG_LEVEL_WRN=y

CONFIG_HEAP_MEM_POOL_SIZE=16384
CONFIG_TEST_RANDOM_GENERATOR=y
CONFIG_TIMER_RANDOM_GENERATOR=y

CONFIG_NET_BUF_RX_COUNT=32
CONFIG_NET_PKT_RX_COUNT=16
CONFIG_NET_BUF_TX_COUNT=32
CONFIG_NET_PKT_TX_COUNT=16
CONFIG_NET_SHELL=y
#
# IP and DHCP not auto setup for sta.
# Softap might need a bit change in Zephyr.
#
CONFIG_NET_CONFIG_AUTO_INIT=n
# Two for sta and softap
CONFIG_NET_IF_MAX_IPV4_COUNT=2
CONFIG_NET_IPV6=n
CONFIG_NET_IPV4=y
CONFIG_NET_MGMT=y
CONFIG_NET_MGMT_EVENT=y

CONFIG_WIFI=y
CONFIG_WIFI_UWP=y
CONFIG_WIFI_UWP_MAX_RX_ADDR_COUNT=32
CONFIG_WIFI_LOG_LEVEL_INF=y

# WiFi manager dependencies
CONFIG_MSG_COUNT_MAX=32
CONFIG_MSG_SIZE_MAX=32
CONFIG_SETTINGS=y
CONFIG_SETTINGS_FCB=y
CONFIG_MBEDTLS=y
CONFIG_MBEDTLS_BUILTIN=y
CONFIG_MBEDTLS_CFG_FILE="config-mini-pbkdf2.h"

# WiFi manager options
CONFIG_WIFIMGR=y
CONFIG_WIFIMGR_SHELL=y
CONFIG_WIFIMGR_AUTORUN=y
CONFIG_WIFIMGR_AP=y
CONFIG_WIFIMGR_STA=y
CONFIG_WIFIMGR_CONFIG_SAVING=y
CONFIG_WIFIMGR_DHCPC=y
CONFIG_WIFIMGR_PSK=y
CONFIG_WIFIMGR_LED=y

#CONFIG_NET_TCP=y
#CONFIG_HTTP=y
#CONFIG_HTTP_CLIENT=y #add by frank.lee

#CONFIG_BT_UWP5661=y
#CONFIG_BT=y
#CONFIG_BT_NO_DRIVER=y
#CONFIG_SYSTEM_WORKQUEUE_STACK_SIZE=4096
#CONFIG_BT_RX_STACK_SIZE=4096
#CONFIG_BT_RX_BUF_LEN=1024
#CONFIG_BT_L2CAP_TX_MTU=255
#CONFIG_BT_L2CAP_RX_MTU=255
#CONFIG_BT_DEVICE_NAME="uwp5661"
#CONFIG_BT_PERIPHERAL=y
#CONFIG_BT_CENTRAL=y
#CONFIG_BT_CONN=y
#CONFIG_BT_SMP=y
#CONFIG_BT_DEBUG_LOG=y
#CONFIG_BT_ATT_PREPARE_COUNT=5

#CONFIG_BT_OBSERVER=y
#CONFIG_BT_BROADCASTER=y
#CONFIG_BT_HCI_VS_EXT=n
#CONFIG_BT_DEBUG_MONITOR=y
#CONFIG_BT_DEBUG_LOG=y
#CONFIG_BT_SMP=y
#CONFIG_BT_TINYCRYPT_ECC=y

#mp_test configs
CONFIG_DHRYSTONE=y
#CONFIG_ENGPC=y
#CONFIG_IWNPI=y
#CONFIG_BT_TEST=y
#CONFIG_ZTEST=y

CONFIG_PINMUX=y
CONFIG_PINMUX_UWP=y

CONFIG_GPIO=y
CONFIG_GPIO_UWP=y
CONFIG_GPIO_UWP_P0=y
# CONFIG_GPIO_UWP_P1=y
# CONFIG_GPIO_UWP_P2=y

CONFIG_WATCHDOG=y
CONFIG_WDT_UWP=y
```

## src/main.c
```c
/*
 * SPDX-License-Identifier: Apache-2.0
 */

#include "logging/log.h"
LOG_MODULE_REGISTER(REPEATER);

#include <zephyr.h>
#include <misc/printk.h>

extern void blues_init(void);
void main(void)
{
	LOG_INF("   [UNISOC Wi-Fi Repeater]");

#ifdef CONFIG_BT_UWP5661
	blues_init();
#endif

	while(1) {}
}
```

## src/log.h
```c
/*
 * SPDX-License-Identifier: Apache-2.0
 */

#ifndef __REPEATER_LOG_H__
#define __REPEATER_LOG_H__


#ifdef __cplusplus
extern "C" {
#endif

#include <logging/log.h>
#define LOG_MODULE_NAME repeater
#define LOG_LEVEL CONFIG_REPEATER_LOG_LEVEL

#ifdef __cplusplus
}
#endif


#endif /* __REPEATER_LOG_H__ */
```

## src/shell.c
```c
/*
 * SPDX-License-Identifier: Apache-2.0
 */

#include "logging/log.h"
LOG_MODULE_DECLARE(REPEATER);

#include <zephyr.h>
#include <misc/printk.h>
#include <shell/shell.h>
#include <stdlib.h>
#include <version.h>

u32_t str2hex(char *s)
{
	u32_t val = 0;
	int len;
	int i;
	char c;

	if (strncmp(s, "0x", 2) && strncmp(s, "0X", 2)) {
		LOG_ERR("Invalid hex string: %s.", s);
		return 0;
	}

	/* skip 0x */
	s += 2;

	len = strlen(s);
	if (len > 8) {
		LOG_ERR("Invalid hex string.");
		return 0;
	}

	for (i = 0; i < len; i++) {
		c = *s;

		/* 0 - 9 */
		if (c >= '0' && c <= '9')
			c -= '0';
		else if (c >= 'A' && c <= 'F')
			c = c - 'A' + 10;
		else if (c >= 'a' && c <= 'f')
			c = c - 'a' + 10;
		else {
			LOG_ERR("Invalid hex string.");
			return 0;
		}

		val = val * 16 + c;

		s++;
	}

	return val;
}

u32_t str2data(char *s)
{
	if (strncmp(s, "0x", 2) == 0 || strncmp(s, "0X", 2) == 0)
		return str2hex(s);
	else
		return atoi(s);
}
void read8_cmd_exe(u32_t addr, u32_t len)
{
	int i;

	printk("Read %d bytes from 0x%x:\n", len, addr);

	for (i = 0; i < len; i++, addr++) {
		if (i%16 == 0)
			printk("\n%08x: ", addr);
		printk("%02x ", sys_read8(addr));
	}
	printk("\n");
}

static int cmd_read8(const struct shell *shell, size_t argc, char **argv)
{
	u32_t addr;
	u32_t len;

	addr = (u32_t)str2data(argv[1]);
	len = str2data(argv[2]);

	read8_cmd_exe(addr, len);

	return 0;
}
void read32_cmd_exe(u32_t addr, u32_t len)
{
	int i;

	printk("Read %d words from 0x%x:\n", len, addr);

	for (i = 0; i < len; i++, addr += 4) {
		if (i%4 == 0)
			printk("\n%08x: ", addr);
		printk("%08x ", sys_read32(addr));
	}
	printk("\n");
}

static int cmd_read32(const struct shell *shell, size_t argc, char **argv)
{
	u32_t addr;
	u32_t len;

	addr = (u32_t)str2data(argv[1]);
	len = str2data(argv[2]);

	read32_cmd_exe(addr, len);

	return 0;
}

static int cmd_write(const struct shell *shell, size_t argc, char **argv)
{
	u32_t p;
	u32_t val;

	p = str2data(argv[1]);
	val = str2data(argv[2]);

	sys_write32(val, p);

	shell_fprintf(shell, SHELL_NORMAL,
			"Write data 0x%x to address 0x%x success.",
			val, p);

	return 0;
}


static int cmd_version(const struct shell *shell, size_t argc, char **argv)
{
	ARG_UNUSED(argc);
	ARG_UNUSED(argv);

	shell_fprintf(shell, SHELL_NORMAL,
			"Zephyr version %s\n", KERNEL_VERSION_STRING);
	return 0;
}

SHELL_STATIC_SUBCMD_SET_CREATE(sub_app,
	SHELL_CMD(version, NULL, "Show kernel version.", cmd_version),
	SHELL_CMD(read8, NULL, "Read memory in byte.\n"
			"Usage: read8 <address> <count>", cmd_read8),
	SHELL_CMD(read32, NULL, "Read memory in word.\n"
			"Usage: read32 <address> <count>", cmd_read32),
	SHELL_CMD(write32, NULL, "Write memory in word.\n"
			"Usage: write32 <address> <value>", cmd_write),
	SHELL_SUBCMD_SET_END /* Array terminated. */
);
/* Creating root (level 0) command "app" */
SHELL_CMD_REGISTER(app, &sub_app, "Function test commands", NULL);
```

## src/test.c
```c
/*
 * SPDX-License-Identifier: Apache-2.0
 */

#include "log.h"
LOG_MODULE_DECLARE(LOG_MODULE_NAME);

#include <zephyr.h>
#include <misc/printk.h>
#include <shell/shell.h>
#include <logging/log.h>
#include <stdlib.h>
#include <device.h>
#include <gpio.h>
#include <uart.h>
#include <led.h>
#include <irq_nextlevel.h>

#include <uwp_hal.h>
#include <pinmux.h>
#include <flash_map.h>

static int cmd_rand(const struct shell *shell, size_t argc, char **argv)
{
	ARG_UNUSED(argc);
	ARG_UNUSED(argv);

	u32_t rand = sys_rand32_get();

	shell_fprintf(shell, SHELL_NORMAL,
			"generate rand: 0x%x\n", rand);
	return 0;
}

#define SOFT_INT_IRQ_NUM	(0x0201)
#define SOFT_INT_FIQ_NUM	(0x0200)
#define SOFT_INT_AON_NUM	(0x0214)
#define	SOFT_IRQ			(0x01)
struct uwp_ictl_data {
	u32_t	base_addr;
};
#define DEV_DATA(dev) \
	((struct uwp_ictl_data * const)(dev)->driver_data)
#define INTC_STRUCT(dev) \
	((volatile struct uwp_intc *)(DEV_DATA(dev))->base_addr)

struct soft_irq {
	char *name;
	u32_t irq_num;
};

struct soft_irq soft_irq[] =
{
	{CONFIG_UWP_ICTL_0_NAME, SOFT_INT_IRQ_NUM},
	{CONFIG_UWP_ICTL_1_NAME, SOFT_INT_FIQ_NUM},
	{CONFIG_UWP_ICTL_2_NAME, SOFT_INT_AON_NUM},
	{NULL, 0}
};

static inline void uwp_ictl_irq_trigger_soft(struct device *dev)
{
	volatile struct uwp_intc *intc = INTC_STRUCT(dev);

	uwp_intc_trigger_soft(intc);
}

static inline void uwp_ictl_irq_clear_soft(struct device *dev)
{
	volatile struct uwp_intc *intc = INTC_STRUCT(dev);

	uwp_intc_clear_soft(intc);
}

static void intc_uwp_soft_irq(void *data)
{
	struct device **dev = (struct device **)data;

	if (!(*dev)) {
		printk("Unknown device: %p.\n", *dev);
		return;
	}

	uwp_ictl_irq_clear_soft(*dev);
	printk("soft irq: %s.\n", (*dev)->config->name);
}

static struct device *intc_irq;
static struct device *intc_fiq;
static struct device *intc_aon;
static int cmd_intc(const struct shell *shell, size_t argc, char **argv)
{
	ARG_UNUSED(argc);
	ARG_UNUSED(argv);


	intc_irq = device_get_binding(CONFIG_UWP_ICTL_0_NAME);
	if (!intc_irq) {
		printk("Can not find device: %s.\n",
				CONFIG_UWP_ICTL_0_NAME);
		return -1;
	}

	IRQ_CONNECT(SOFT_INT_IRQ_NUM, 0,
				intc_uwp_soft_irq,
				&intc_irq, 0);
	irq_enable_next_level(intc_irq, SOFT_IRQ);
	uwp_ictl_irq_trigger_soft(intc_irq);

	intc_fiq = device_get_binding(CONFIG_UWP_ICTL_1_NAME);
	if (intc_fiq == NULL) {
		printk("Can not find device: %s.\n",
				CONFIG_UWP_ICTL_1_NAME);
		return -1;
	}

	IRQ_CONNECT(SOFT_INT_FIQ_NUM, 0,
				intc_uwp_soft_irq,
				&intc_fiq, 0);
	irq_enable_next_level(intc_fiq, SOFT_IRQ);
	uwp_ictl_irq_trigger_soft(intc_fiq);

	intc_aon = device_get_binding(CONFIG_UWP_ICTL_2_NAME);
	if (intc_aon == NULL) {
		printk("Can not find device: %s.\n",
				CONFIG_UWP_ICTL_2_NAME);
		return -1;
	}

	IRQ_CONNECT(SOFT_INT_AON_NUM, 0,
				intc_uwp_soft_irq,
				&intc_aon, 0);
	irq_enable_next_level(intc_aon, SOFT_IRQ);
	uwp_ictl_irq_trigger_soft(intc_aon);

	return 0;
}

static int cmd_sleep(const struct shell *shell, size_t argc, char **argv)
{
	int time;

	time = atoi(argv[1]);
	shell_fprintf(shell, SHELL_NORMAL,
			"sleep %ims start...\n", time);

	k_sleep(time);

	shell_fprintf(shell, SHELL_NORMAL,
			"sleep stop.\n");

	return 0;
}

#define GPIO_PORT0	DT_GPIO_PO_UWP_NAME
#define UART_2			"UART_2"
static int cmd_uart(const struct shell *shell, size_t argc, char **argv)
{
	struct device *uart;
	char *str = "This is a test message from test command.\r\n";

	uart = device_get_binding(UART_2);
	if (uart == NULL) {
		shell_fprintf(shell, SHELL_ERROR,
				"Can not find device %s.\n", UART_2);
		return -1;
	}

	uart_irq_rx_enable(uart);

	uart_fifo_fill(uart, str, strlen(str));

	shell_fprintf(shell, SHELL_NORMAL,
			"test uart %s finish.\n", UART_2);

	return 0;
}

#ifdef CONFIG_LED_UWP
#define LED_NAME DT_GPIO_LEDS_NAME
#define LED_PIN1 DT_GPIO_LEDS_LED_1_PIN
#define LED_PIN2 DT_GPIO_LEDS_LED_2_PIN
#define LED_PIN3 DT_GPIO_LEDS_LED_3_PIN
static int cmd_led(const struct shell *shell, size_t argc, char **argv)
{
	struct device *led_dev;
	int led_pin, led;
	int on_off;
	int err = shell_cmd_precheck(shell, (argc == 3), NULL, 0);

	if (err) {
		return err;
	}

	led_dev = device_get_binding(LED_NAME);
	if (!led_dev) {
		shell_fprintf(shell, SHELL_ERROR,
				"Can not find device %s.\n", LED_NAME);
		return -1;
	}

	led = atoi(argv[1]);
	on_off = atoi(argv[2]);
	led_pin = LED_PIN1;

	switch (led) {
	case 1:
		led_pin = LED_PIN1; break;
	case 2:
		led_pin = LED_PIN2; break;
	case 3:
		led_pin = LED_PIN3; break;
	default:
		return -1;
	}

	if (on_off) {
		led_on(led_dev, led_pin);
	} else {
		led_off(led_dev, led_pin);
	}

	return 0;
}
#else
static int cmd_led(const struct shell *shell, size_t argc, char **argv)
{
	printk("CONFIG_LED is not enabled!\n");
	return 0;
}
#endif

#if defined(CONFIG_PINMUX_UWP) && defined (CONFIG_GPIO_UWP)
static struct gpio_callback button_cb;
int count;
#define BUTTON_PIN 0
#define GPIO0_REG (BASE_AON_PIN+0x10)
#define PMUX_DEV "pinmux_drv"

static void button_callback(struct device *port, struct gpio_callback *cb,
				 u32_t pin)
{
	printk("button pressed.\n");
}

static int cmd_button(const struct shell *shell, size_t argc, char **argv)
{
	struct device *gpio, *pmx_dev;

	gpio = device_get_binding(GPIO_PORT0);
	if (!gpio) {
		printk("Can not find device %s.\n", GPIO_PORT0);
		return -1;
	}
	pmx_dev = device_get_binding(PMUX_DEV);
	if (!pmx_dev) {
		printk("Can not find device %s.\n", PMUX_DEV);
		return -1;
	}
	count = 0;
	gpio_pin_configure(gpio, BUTTON_PIN, (GPIO_DIR_IN | GPIO_INT
			| GPIO_INT_EDGE | GPIO_PUD_PULL_UP
			| GPIO_INT_ACTIVE_LOW));
	pinmux_pin_pullup(pmx_dev, PIN_GPIO0_REG, PMUX_FPU_EN);

	gpio_init_callback(&button_cb, button_callback, BIT(BUTTON_PIN));
	gpio_add_callback(gpio, &button_cb);
	gpio_pin_enable_callback(gpio, BUTTON_PIN);

	return 0;
}
#else
static int cmd_button(const struct shell *shell, size_t argc, char **argv)
{
	printk("CONFIG_PINMUX_UWP or CONFIG_GPIO_UWP is not enabled!\n");
	return 0;
}
#endif

#if defined(CONFIG_PINMUX_UWP) && defined (CONFIG_GPIO_UWP)
#define PIN10 10
#define PULLUP 1
#define PMUX_DEV "pinmux_drv"
int reset_misc(void)
{
	struct device *pm_dev, *p0_dev;

	pm_dev = device_get_binding(PMUX_DEV);
	if (!pm_dev) {
		printk("Can not find device %s.\n", PMUX_DEV);
		return -1;
	}
	p0_dev = device_get_binding(GPIO_PORT0);
	if (!p0_dev) {
		printk("Can not find device %s.\n", GPIO_PORT0);
		return -1;
	}
	/*set INT as GPIO10*/
	pinmux_pin_set(pm_dev, PIN_INT_REG, PIN_FUNC_3);
	printk("set INT as GPIO10\n");
	/*set GPIO10 DIR out and enable GPIO10 */
	gpio_pin_configure(p0_dev, PIN10, GPIO_DIR_OUT);
	/*pull up GPIO10*/
	gpio_pin_write(p0_dev, PIN10, PULLUP);

	return 0;
}
static int cmd_reset(const struct shell *shell, size_t argc, char **argv)
{
	printk("resetting ...\n");
	k_sleep(50);				/* wait 50 ms */

	reset_misc();

	return 0;
}
#else
static int cmd_reset(const struct shell *shell, size_t argc, char **argv)
{
	printk("CONFIG_PINMUX_UWP or CONFIG_GPIO_UWP is not enabled!\n");
	return 0;
}
#endif

static int cmd_wipe_all_config(const struct shell *shell,
			size_t argc, char *argv[])
{
	const struct flash_area *fap;
	int rc;

	rc = flash_area_open(DT_FLASH_AREA_STORAGE_ID, &fap);

	if (rc == 0) {
		rc = flash_area_erase(fap, 0, fap->fa_size);
		flash_area_close(fap);
		printk("\n###################################\n");
		printk("wipe success! please reset system! ..........\n");
		printk("###################################\n\n");
	}

	return rc;
}

SHELL_STATIC_SUBCMD_SET_CREATE(sub_test,
	SHELL_CMD(rand, NULL, "Generate random number.", cmd_rand),
	SHELL_CMD(intc, NULL, "Triger soft irq.", cmd_intc),
	SHELL_CMD(uart, NULL, "Fill a message to UART.", cmd_uart),
	SHELL_CMD(sleep, NULL, "Sleep for (n) micro seconds.\n"
			"Usage: sleep <ms>", cmd_sleep),
	SHELL_CMD(led, NULL, "Control led to turn on/off.\n"
			"Usage: led <led's number> <on/off>\n"
			"parameters:\n"
			"led's number: 1/2/3.\n"
			"\t   on/off: 1/0", cmd_led),
	SHELL_CMD(button, NULL, "Push button to control led3",
			cmd_button),
	SHELL_CMD(reset, NULL, "Reset the board",
			cmd_reset),
	SHELL_CMD(wipe, NULL, "wipe all configs in userdata partition.",
			cmd_wipe_all_config),
	SHELL_SUBCMD_SET_END /* Array terminated. */
);
/* Creating root (level 0) command "test" */
SHELL_CMD_REGISTER(test, &sub_test, "Function test commands", NULL);
```
